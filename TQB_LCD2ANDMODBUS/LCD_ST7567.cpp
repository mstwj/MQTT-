#include "LCD_ST7567.h"

// Keil原版标准5x8 ASCII字库 95个字符(空格~~)
const unsigned char ascii_table_5x8[95][5]={
0x00,0x00,0x00,0x00,0x00,//space 
0x00,0x00,0x4f,0x00,0x00,//! 
0x00,0x07,0x00,0x07,0x00,//" 
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0x04,0x02,0x02,0x02,0x01,//~ 
};

// 底层SPI发送1字节
void LCD_ST7567::Writ_Bus(uint8_t dat)
{
  LCD_CS_Clr();
  delayMicroseconds(1);
  for(uint8_t i=0;i<8;i++)
  {
    LCD_SCLK_Clr();
    delayMicroseconds(1);
    if(dat & 0x80)
      LCD_MOSI_Set();
    else
      LCD_MOSI_Clr();
    delayMicroseconds(1);
    LCD_SCLK_Set();
    delayMicroseconds(1);
    dat <<= 1;
    delayMicroseconds(1);
  }
  LCD_CS_Set();
}

// 写数据RAM
void LCD_ST7567::WR_DATA(uint8_t dat)
{
  LCD_RS_Set();
  Writ_Bus(dat);
}

// 写命令寄存器
void LCD_ST7567::WR_REG(uint8_t cmd)
{
  LCD_RS_Clr();
  delayMicroseconds(1);
  Writ_Bus(cmd);
  delayMicroseconds(1);
  LCD_RS_Set();
}

// 设置坐标 x列0~127  y页0~7
void LCD_ST7567::SetPos(uint8_t x, uint8_t y)
{
  WR_REG(0xb0 + y);
  WR_REG(((x >> 4) & 0x0F) | 0x10);
  WR_REG(x & 0x0F);
}

// 全屏清屏
void LCD_ST7567::Clear(void)
{
  uint8_t y,x;
  for(y=0;y<8;y++)
  {
    SetPos(0,y);
    for(x=0;x<128;x++)
    {
      WR_DATA(0x00);
    }
  }
}

// 单字符显示 修正参数 x,y,ch
void LCD_ST7567::ShowChar(uint8_t x, uint8_t y, char ch)
{
  uint8_t idx;
  idx = (uint8_t)ch - 32;
  if(idx > 94)
    return;

  SetPos(x, y);
  for(uint8_t i=0; i<5; i++)
  {
    WR_DATA(ascii_table_5x8[idx][i]);
    x++;
  }
}

// 字符串显示
void LCD_ST7567::ShowString(uint8_t x,uint8_t y,char *str)
{
  while(*str != '\0')
  {
    ShowChar(x, y, *str);
    x += 5;
    if(x > 123)
    {
      x = 0;
      y += 1;
      if(y >= 8)
        y = 0;
    }
    str++;
  }
}

// 屏幕初始化
void LCD_ST7567::Init(void)
{
  pinMode(LCD_CS, OUTPUT);
  pinMode(LCD_SCLK, OUTPUT);
  pinMode(LCD_RS, OUTPUT);
  pinMode(LCD_MOSI, OUTPUT);
  pinMode(LCD_RES, OUTPUT);
  pinMode(LCD_BLK, OUTPUT);

  LCD_CS_Set();
  LCD_SCLK_Set();
  LCD_RS_Set();
  LCD_MOSI_Set();
  LCD_RES_Set();
  LCD_BLK_Set();
  delay(100);

  LCD_RES_Clr();
  delay(200);
  LCD_RES_Set();
  delay(100);

  LCD_BLK_Set();
  delay(100);

  LCD_CS_Clr();
  WR_REG(0xE2); delay(3);
  WR_REG(0x2C); delay(3);
  WR_REG(0x2E); delay(3);
  WR_REG(0x2F); delay(3);
  WR_REG(0x24);
  WR_REG(0x81);
  WR_REG(0x09);
  WR_REG(0xa2);
  WR_REG(0xc8);
  WR_REG(0xa0);
  WR_REG(0x40);
  WR_REG(0xaf);
  LCD_CS_Set();
}